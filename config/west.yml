## config/west.yml
```yaml
manifest:
  remotes:
    - name: zmkfirmware
      url-base: https://github.com/zmkfirmware
    - name: stmotorspark
      url-base: https://github.com/StMotorSpark
  projects:
    - name: zmk
      remote: stmotorspark
      revision: mouse-niceview-stms 
      import: app/west.yml
  self:
    path: config
```
